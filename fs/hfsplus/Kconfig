## fs/hfsplus/Kconfig
```kconfig
config HFSPLUS_FS
	tristate "Apple Extended HFS file system support"
	depends on BLOCK
	select NLS
	select NLS_UTF8
	help
	  If you say Y here, you will be able to mount extended format
	  Macintosh-formatted hard drive partitions with full read-write access.

	  This file system is often called HFS+ and was introduced with
	  MacOS 8. It includes all Mac specific filesystem data such as
	  data forks and creator codes, but it also has several UNIX
	  style features such as file ownership and permissions.

config HFSPLUS_FS_RICHACL
	bool "HFS+ Rich Access Control Lists (EXPERIMENTAL)"
	depends on HFSPLUS_FS && EXPERIMENTAL
	select FS_RICHACL
	help
	  Rich ACLs are an implementation of NFSv4 ACLs, extended by file masks
	  to fit into the standard POSIX file permission model.  They are
	  designed to work seamlessly locally as well as across the NFSv4 and
	  CIFS/SMB2 network file system protocols.

	  Mac OS X beginning with version 10.4 ("Tiger") support NFSv4 ACLs,
	  which are part of the NFSv4 standard. HFS+ stores ACLS in the form of
	  specially named extended attributes (com.apple.system.Security).

	  To learn more about Rich ACL, visit
	  http://acl.bestbits.at/richacl/

	  If you don't know what Rich ACLs are, say N
```

## fs/nilfs2/Kconfig
```kconfig
config NILFS2_FS
	tristate "NILFS2 file system support"
	select CRC32
	help
	  NILFS2 is a log-structured file system (LFS) supporting continuous
	  snapshotting.  In addition to versioning capability of the entire
	  file system, users can even restore files mistakenly overwritten or
	  destroyed just a few seconds ago.  Since this file system can keep
	  consistency like conventional LFS, it achieves quick recovery after
	  system crashes.

	  NILFS2 creates a number of checkpoints every few seconds or per
	  synchronous write basis (unless there is no change).  Users can
	  select significant versions among continuously created checkpoints,
	  and can change them into snapshots which will be preserved for long
	  periods until they are changed back to checkpoints.  Each
	  snapshot is mountable as a read-only file system concurrently with
	  its writable mount, and this feature is convenient for online backup.

	  Some features including atime, extended attributes, and POSIX ACLs,
	  are not supported yet.

	  To compile this file system support as a module, choose M here: the
	  module will be called nilfs2.  If unsure, say N.

if NILFS2_FS

config NILFS2_DEBUG
	bool "NILFS2 debugging"
	default n
	help
	  If you are experiencing any problems with the NILFS2 filesystem, say
	  Y here.  This will result in additional debugging messages to be
	  written to the system log.  Under normal circumstances, this
	  results in very little overhead.

if NILFS2_DEBUG

config NILFS2_DEBUG_SHOW_ERRORS
	bool "Show internal errors"
	default n
	help
	  This option enables writing in system log messages about internal
	  errors of NILFS2 driver. Every such message records file, function,
	  line and code of error. These types of debugging messages can be
	  very usefull for understanding and analyzing reasons of an issue.

config NILFS2_DEBUG_DUMP_STACK
	bool "Enable dump stack output"
	default n
	help
	  This option enables output of dump stack. Usually, every
	  function in NILFS2 driver begins from debugging output of
	  function name, file, line and input arguments' value.
	  In the case of enabling this option debugging output
	  will include dump stack too.

	  Usually, dump stacks are printed out for called functions from
	  files that are requested by flags. But dump stacks are
	  printed out for all called functions in the case of dynamic
	  debug (CONFIG_NILFS2_USE_PR_DEBUG).

config NILFS2_DEBUG_SUBSYSTEMS
	bool "Enable output from subsystems"
	depends on NILFS2_DEBUG
	default n
	help
	  This option groups opportunity to enable debugging output from
	  concrete NILFS2 driver's subsystems.

if NILFS2_DEBUG_SUBSYSTEMS

config NILFS2_DEBUG_BASE_OPERATIONS
	bool "Enable base operations subsystem debugging output"
	default n
	help
	  This option enables debugging output in super.c, the_nilfs.c,
	  namei.c, ioctl.c, inode.c, file.c, dir.c modules.

config NILFS2_DEBUG_MDT_FILES
	bool "Enable metadata (MDT) files subsystem debugging output"
	default n
	help
	  This option enables debugging output in mdt.c, cpfile.c, dat.c,
	  ifile.c, sufile.c modules.

config NILFS2_DEBUG_SEGMENTS_SUBSYSTEM
	bool "Enable segments subsystem debugging output"
	default n
	help
	  This option enables debugging output in segbuf.c, segment.c
	  modules.

config NILFS2_DEBUG_GC_SUBSYSTEM
	bool "Enable GC subsystem debugging output"
	default n
	help
	  This option enables debugging output in gcinode.c module.

config NILFS2_DEBUG_RECOVERY_SUBSYSTEM
	bool "Enable recovery subsystem debugging output"
	default n
	help
	  This option enables debugging output in recovery.c module.

config NILFS2_DEBUG_BLOCK_MAPPING
	bool "Enable block mapping subsystem debugging output"
	default n
	help
	  This option enables debugging output in alloc.c, bmap.c, btnode.c,
	  btree.c, direct.c modules.

config NILFS2_DEBUG_BUFFER_MANAGEMENT
	bool "Enable buffer/page management subsystem debugging output"
	default n
	help
	  This option enables debugging output in page.c module.

config NILFS2_DEBUG_SHOW_SPAM
	bool "Enable superfluous debugging output"
	default n
	help
	  This option enables output from frequently called functions or
	  detailed debugging output from function's body. Please, be
	  cautious with enabling the option. Because it can be resulted
	  in huge amount of debugging messages in system log and
	  performance decreasing. Please, remember that superfluos output
	  option is depended implicitly from options that enable output of
	  concrete modules of NILFS2 driver.

config NILFS2_DEBUG_HEXDUMP
	bool "Enable debugging hexdump of internal structures"
	default n
	help
	  This option enables writing in system log hexdumps of internal
	  structures. Some of big internal and raw on-disk structures can be
	  written in system log for deep analysis of processed data related
	  to an issue. Please, remember that hexdump output is depended
	  implicitly from options that enable output of concrete modules of
	  NILFS2 driver. It makes sense to log hexdumps only for modules that
	  have enabled debugging output.

endif # NILFS2_DEBUG_SUBSYSTEMS

endif # NILFS2_DEBUG

endif # NILFS2_FS
```
